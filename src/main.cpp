/*
DO NOT STEAL THIS CODE.
THIS IS FOR DAS ALLEWACHSEN.
PLEASE SEE THE LICENCE

https://github.com/Yellowstrawberrys/Das-AlleWachsen

*/


//Default
#include <Arduino.h>

//Display
#include <SPI.h>
#include <Wire.h>
#include <Adafruit_GFX.h>
#include <Adafruit_SH110X.h>

#define i2c_Address 0x3c //SCK -> A4 & SDA -> A5
#define SCREEN_WIDTH 128 // OLED display width, in pixels
#define SCREEN_HEIGHT 64 // OLED display height, in pixels
#define OLED_RESET -1   //   QT-PY / XIAO
Adafruit_SH1106G display = Adafruit_SH1106G(SCREEN_WIDTH, SCREEN_HEIGHT, &Wire, OLED_RESET); //Create display obj


//Bluetooth
#include <SoftwareSerial.h> 

#define bt_rx 3
#define bt_tx 2

SoftwareSerial bluetooth(bt_tx, bt_rx);

//DHT
#include "DHT.h"
#define DHTPIN 7
#define DHTTYPE DHT11
DHT dht(DHTPIN, DHTTYPE);
float h = dht.readHumidity();
float t = dht.readTemperature();

//Soil
#define SensorPin A1
float sensorValue = 0; 

//Temperature
#define FAN1_VCC 8
#define FAN1_GND 9
#define FAN2_VCC 10
#define FAN2_GND 11

//Light Control
#define LightPin 4

//Water Pump Control
#define WaterPump_VCC 5
#define WaterPump_GND 6

// 'Das AlleWachsen', 128x64px
const unsigned char epd_bitmap_Das_AlleWachsen [] PROGMEM = {
  0xff, 0xff, 0xff, 0xff, 0xff, 0xff, 0xff, 0xff, 0xff, 0xff, 0xff, 0xff, 0xff, 0xff, 0xff, 0xff, 
  0xc7, 0xf7, 0x83, 0xff, 0xff, 0xff, 0xff, 0xff, 0xff, 0xff, 0xff, 0xff, 0xff, 0xff, 0xff, 0xff, 
  0xdb, 0xeb, 0xbf, 0xff, 0xff, 0xff, 0xff, 0xff, 0xff, 0xff, 0xff, 0xff, 0xff, 0xff, 0xff, 0xff, 
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  0xff, 0xff, 0xff, 0xff, 0xff, 0xff, 0xff, 0xff, 0xff, 0xff, 0xff, 0xff, 0xff, 0xff, 0xff, 0xff
};

// Array of all bitmaps for convenience. (Total bytes used to store images in PROGMEM = 1040)
const int epd_bitmap_allArray_LEN = 1;
const unsigned char* epd_bitmap_allArray[1] = {
  epd_bitmap_Das_AlleWachsen
};


void setup() {
  //Begins Serial with 9600 board-rate
  Serial.begin(9600);

  //Frist Screen
  delay(250);
  display.begin(i2c_Address, true);
  display.clearDisplay();
  display.display();

  display.clearDisplay();
  display.drawBitmap(0, 0,  epd_bitmap_Das_AlleWachsen, 128, 64, 1);
  display.display();

  bluetooth.begin(9600);
  bluetooth.write("AT+NAMEDas_AlleWachsen");
  dht.begin();
  delay(2000);

  display.clearDisplay();
  display.setTextSize(1);
  display.setTextColor(SH110X_WHITE);
  display.println("Connect to Bluetooth");
  display.println("\nID> Das AlleWachsen\nPW> 1234");
  display.display();
}

void loop() {
  // put your main code here, to run repeatedly:
  if(bluetooth.available() > 0){
     char c = bluetooth.read();
     Serial.println(c);
  }
   for (int i = 0; i <= 100; i++) 
   { 
     sensorValue = sensorValue + analogRead(SensorPin); 
     delay(1); 
   } 
   sensorValue = sensorValue/100.0; 
   if(sensorValue < 40){
      Serial.print("WATER");
   }
   if(h < 50){
      Serial.print("MORE WATER IN AIR");    
   }
   if(t > 30){
      Serial.print("Cooling System.");
   }else if(t < 20){
      Serial.print("Heating System.");
   }
   delay(100);
}